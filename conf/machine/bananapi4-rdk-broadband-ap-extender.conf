## conf/machine/bananapi4-rdk-broadband-ap-extender.conf
```bitbake
#@TYPE: Machine
#@NAME: bananapi4-rdk-broadband-ap-extender
#@NEEDED_BSPLAYERS: meta-cmf-bananapi
#@DESCRIPTION: Machine configuration for running a RDK broadband on Banana Pi R4
#@RDK_FLAVOR: rdkb

RUST_PANIC_STRATEGY="abort"

require conf/machine/filogic880-bpi-r4.conf
DISTRO_FEATURES_append = " em_extender"
require conf/distro/include/rdk-bpi-ap-extender.inc 
PREFERRED_PROVIDER_hal-wifi_onewifi = "hal-wifi-generic"
MACHINE_IMAGE_NAME = "rdk-generic-ap-extender-image"

#SDCARD supported changes.
MACHINEOVERRIDES .="${@bb.utils.contains('DISTRO_FEATURES','sdmmc',':sd','',d)}"
IMAGE_FSTYPES += "${@bb.utils.contains('DISTRO_FEATURES','sdmmc','wic.bz2 ext4','',d)}"
KERNEL_DEVICETREE_mt7988_bpi4_sd = "mediatek/mt7988a-bananapi-bpi-r4-sd.dtb"

WKS_FILE = " ${@bb.utils.contains('DISTRO_FEATURES','EasyMesh',' sdimage-EM-Bananapi.wks',' sdimage-Bananapi.wks',d)}"
IMAGE_BOOT_FILES = "${@bb.utils.contains('DISTRO_FEATURES','sdmmc','mt7988a-bananapi-bpi-r4-sd.dtb ${KERNEL_IMAGETYPE}','',d)}"
do_image_wic[recrdeps] = "do_build"
#SDCARD supported Pre build bootloader
do_image_wic[depends] += " atf_bootloader_prebuild:do_deploy"
```

## wic/sdimage-Bananapi.wks
```
# short-description: Custom Bananapi R4 SD card image
# long-description: Creates a partitioned SD card image with dual-bank layout and additional RDK-B partitions.
#
bootloader --ptable gpt --timeout=0

# 1. BL2 (aligned at 17 sectors, 4079KB)
part --source rawcopy --sourceparams="file=atf/bpi-r4_sdmmc_bl2.img" --part-name bl2 --align 17 --fixed-size 4079K --active --part-type=0FC63DAF-8483-4772-8E79-3D69D8477DE4


# 2. FIP (aligned at 6656 sectors, 2048KB)
part --source rawcopy --sourceparams="file=atf/bpi-r4_sdmmc_fip.bin" --part-name fip --align 6656 --fixed-size 2M --part-type=0FC63DAF-8483-4772-8E79-3D69D8477DE4

# 3. Boot A
part /boot --source bootimg-partition --ondisk mmcblk0 --fstype=vfat --label boot_a --active --align 8704 --fixed-size 16M --part-type=0FC63DAF-8483-4772-8E79-3D69D8477DE4

# 4. rootfs A
part / --source rootfs --ondisk mmcblk0 --fstype=ext4 --label rootfs_a --fixed-size 1024M

# 5. BL2 B (copy of BL2)
part --source rawcopy --sourceparams="file=atf/bpi-r4_sdmmc_bl2_B.img" --part-name bl2_b --fixed-size 4079K --part-type=0FC63DAF-8483-4772-8E79-3D69D8477DE4

# 6. FIP B (copy of FIP)
part --source rawcopy --sourceparams="file=atf/bpi-r4_sdmmc_fip_B.bin" --part-name fip_b --fixed-size 2M --part-type=0FC63DAF-8483-4772-8E79-3D69D8477DE4

# 7. Boot B
part --source bootimg-partition --ondisk mmcblk0 --fstype=vfat --label boot_b --active --fixed-size 16M --part-type=0FC63DAF-8483-4772-8E79-3D69D8477DE4

# 8. rootfs B
part / --source rootfs --ondisk mmcblk0 --fstype=ext4 --label rootfs_b --fixed-size 1024M

# 9. NVRAM (2MB)
part --source=empty --fstype=ext4 --label=nvram --fixed-size=2M

# 10. Crash_a Debug (8MB)
part --source=empty --fstype=ext4 --label=crash_a --fixed-size=8M

# 11. Crash_b Debug (8MB)
part --source=empty --fstype=ext4 --label=crash_b --fixed-size=8M

# 12. Reserved (16MB)
part --source=empty --fstype=ext4 --label=reserved --fixed-size=16M

# 13. DAC 
part --source=empty --fstype=ext4 --label=dac --fixed-size=32M
```
