## conf/distro/include/rdk-bpi-ap-extender.inc
```bitbake
DISTRO_FEATURES:append = " halVersion3"

#rdk-wifi-libhostap support for broadband
DISTRO_FEATURES:append = " HOSTAPD_2_11"

# OneWifi feature
DISTRO_FEATURES:append = " OneWifi onewifi_integration"

# MacFilter Feature
DISTRO_FEATURES:append = " acl_nl_support"

#No Moca Support
DISTRO_FEATURES:append = " no_moca_support"
DISTRO_FEATURES:append = " referencepltfm "

MACHINEOVERRIDES:append = "${@bb.utils.contains('DISTRO_FEATURES', 'OneWifi', ':onewifi', '' ,d)}"

MACHINEOVERRIDES:append = "${@bb.utils.contains('DISTRO_FEATURES', 'kernel6-6', ':kernel6-6', bb.utils.contains('DISTRO_FEATURES', 'kernel6-12', ':kernel6-12','',d), d)}"

DISTRO_FEATURES:append = " partner_default_ext"

# Define extender feature
DISTRO_FEATURES:append = " em_extender"
DISTRO_FEATURES:append = " sdmmc"

# Easymesh
DISTRO_FEATURES:append = " EasyMesh"
DISTRO_FEATURES:append = " with_alsap" 

# MLO
DISTRO_FEATURES:append = " CONFIG_IEEE80211BE"
DISTRO_FEATURES:append = " generic_mlo"
#PPP Feature
#DISTRO_FEATURES:append = "ppp-enabled"

# Kernel 6.6
DISTRO_FEATURES:append = " kernel6-6"
#DISTRO_FEATURES:append = " kernel6-12"

#Disable rdm-agent for reference platform
#DISTRO_FEATURES:append = "RDM"

#Enable below distro to build Easymesh and dependent Wi-Fi components from tip (AUTOREV) during CI validation
#DISTRO_FEATURES:append = " BuildFromTip"
```

## conf/distro/include/rdk-bpi.inc
```bitbake
# USP-PA Feature
DISTRO_FEATURES:append = " usppa"

DISTRO_FEATURES:append = " WanManagerUnificationEnable"

DISTRO_FEATURES:append = " rdkb_wan_manager"

DISTRO_FEATURES:append = " halVersion3"

DISTRO_FEATURES_append = " bridgeUtilsBin"

#rdk-wifi-libhostap support for broadband
DISTRO_FEATURES:append = " HOSTAPD_2_11"

# OneWifi feature
DISTRO_FEATURES:append = " OneWifi onewifi_integration"

#No Moca Support
DISTRO_FEATURES:append = " no_moca_support"

DISTRO_FEATURES:append = " referencepltfm "

MACHINEOVERRIDES:append =. "${@bb.utils.contains('DISTRO_FEATURES', 'OneWifi', ':onewifi', '' ,d)}"

MACHINEOVERRIDES:append = "${@bb.utils.contains('DISTRO_FEATURES', 'kernel6-6', ':kernel6-6', bb.utils.contains('DISTRO_FEATURES', 'kernel6-12', ':kernel6-12','',d), d)}"

DISTRO_FEATURES:append = " CPUPROCANALYZER_BROADBAND"

# RDKB-51565,RDKB-50795: [HAL] Cellular Hal Implementation
DISTRO_FEATURES:append = " rdkb_cellular_manager_mm"

DISTRO_FEATURES:append = " partner_default_ext"

#Enable SDcard image as default
DISTRO_FEATURES:append = " sdmmc"

DISTRO_FEATURE:append = " rdkb_voice_manager_dmltr104_v2"

DISTRO_FEATURE:append = " telco_voice_feature_enable_persist"

#PPP Feature
#DISTRO_FEATURES:append = "ppp-enabled"

#disabling lan0_as_wan to allow lan0 interface to come
DISTRO_FEATURES:remove = " lan0_as_wan"

#Need to enable below distro once required changes are merged 
#DISTRO_FEATURES:append = " EasyMesh"
#DISTRO_FEATURES:append = " with_alsap"
#DISTRO_FEATURES:append = " Em_Unittest"
PREFERRED_VERSION_go = "1.24.%"

#Enable below distro to build Easymesh and dependent Wi-Fi components from tip (AUTOREV) during CI validation
#DISTRO_FEATURES_append = " BuildFromTip"

#Enable wps support
DISTRO_FEATURES:append = " wps_support"

#Enable resource optimization
DISTRO_FEATURES:append = " resource_optimization"

#Enable kernel_6_6 support
#DISTRO_FEATURES:append = " kernel6-6"
DISTRO_FEATURES:append = " kernel6-12"
PREFERRED_VERSION_linux-libc-headers:wrynose = "6.12"

DISTRO_FEATURES:append = " CONFIG_IEEE80211BE"

DISTRO_FEATURES:append = " matter"
PREFERRED_VERSION_barton-matter = "1.4.2"

DISTRO_FEATURES:append = " generic_mlo"

#Enable the below DISTRO to enable Hybrid Hal(rndis/modem) for cellular devices
#DISTRO_FEATURES:append_broadband = " cellular_hybrid_support"

#Disable rdm-agent for reference platform
#DISTRO_FEATURES:append = "RDM"

DISTRO_FEATURES:append = " dhcp_manager "
DISTRO_FEATURES:append = " rdkb_configurable_wan_interface"
#Enable remote debugger
DISTRO_FEATURES:append = " rrd"

#Enable MAP-T
DISTRO_FEATURES:append = " feature_mapt"
DISTRO_FEATURES:append = " nat46"
LINUXLIBCVERSION = "${@bb.utils.contains('DISTRO_FEATURES', 'kernel6-12', '6.12%', bb.utils.contains('DISTRO_FEATURES','kernel6-6', '6.6%', '5.4%',d), d)}"
```

## conf/layer.conf
```bitbake
BBPATH .= ":${LAYERDIR}"
BBFILES += "\
            ${LAYERDIR}/meta*/recipes-*/*/*.bb \
            ${LAYERDIR}/meta*/recipes-*/*/*.bbappend \
            ${LAYERDIR}/recipes-*/*/*.bb \
            ${LAYERDIR}/recipes-*/*/*.bbappend \
           "

BBFILE_COLLECTIONS += "cmf-bananapi"
BBFILE_PATTERN_cmf-bananapi := "^${LAYERDIR}/"

LAYERDEPENDS_cmf-bananapi = "cmf-filogic"
LAYERDEPENDS_cmf-bananapi_append = " filogic"

require ${@bb.utils.contains('DISTRO_FEATURES', 'em_extender','conf/distro/include/rdk-bpi-ap-extender.inc','conf/distro/include/rdk-bpi.inc', d)}
require ${@bb.utils.contains('DISTRO_FEATURES', 'em_extender','conf/include/rdk-bpi-ap-extender-bbmasks.inc','conf/include/rdk-bpi-bbmasks.inc', d)}

# EasyMesh WPS for both gateway and extender. Controller builds get
# UWM_CTRL_WPS_SUPPORT; extender builds get UWM_EXT_WPS_SUPPORT.
require conf/distro/include/em-wps-support.inc

LAYERSERIES_COMPAT_cmf-bananapi = " kirkstone"

MIDDLEWARE_ARCH = "${MACHINE}"
PACKAGE_EXTRA_ARCHS_append = " ${MIDDLEWARE_ARCH}"
```

## conf/machine/bananapi4-rdk-broadband.conf
```bitbake
#@TYPE: Machine
#@NAME: bananapi4-rdk-broadband
#@NEEDED_BSPLAYERS: meta-cmf-bananapi
#@DESCRIPTION: Machine configuration for running a RDK broadband on Banana Pi R4
#@RDK_FLAVOR: rdkb

require ${@bb.utils.contains('DISTRO_FEATURES','kernel6-12','conf/machine/filogic880-kernel6-12-bpi-r4.conf', bb.utils.contains('DISTRO_FEATURES','kernel6-6','conf/machine/filogic880-kernel6-6-bpi-r4.conf','conf/machine/filogic880-bpi-r4.conf',d),d)}

require conf/distro/include/rdk-bpi.inc 
PREFERRED_PROVIDER_hal-wifi_onewifi = "hal-wifi-generic"
MACHINE_IMAGE_NAME = "${@bb.utils.contains('DISTRO_FEATURES','BuildFromTip','rdkb-generic-ci-em-ctrl-broadband-image', bb.utils.contains('DISTRO_FEATURES','EasyMesh','rdkb-generic-em-ctrl-broadband-image','rdkb-generic-broadband-image',d),d)}"
MACHINEOVERRIDES .= ":mt7988"

#SDCARD supported changes.
MACHINEOVERRIDES .="${@bb.utils.contains('DISTRO_FEATURES','sdmmc',':sd','',d)}"
IMAGE_FSTYPES += "${@bb.utils.contains('DISTRO_FEATURES','sdmmc',' wic.bz2 ext4','',d)}"
KERNEL_DEVICETREE_mt7988_bpi4_sd = "${@bb.utils.contains_any('DISTRO_FEATURES','kernel6-6 kernel6-12','mediatek/mt7988a-bananapi-bpi-r4.dtb','mediatek/mt7988a-bananapi-bpi-r4-sd.dtb', d)}"

WKS_FILE = "${@bb.utils.contains_any('DISTRO_FEATURES', 'kernel6-6 kernel6-12', 'sdimage-Bananapi_6-6.wks', 'sdimage-Bananapi.wks', d)}"
IMAGE_BOOT_FILES = "${@bb.utils.contains('DISTRO_FEATURES','sdmmc', bb.utils.contains_any('DISTRO_FEATURES','kernel6-6 kernel6-12','mt7988a-bananapi-bpi-r4.dtb ${KERNEL_IMAGETYPE}','mt7988a-bananapi-bpi-r4-sd.dtb ${KERNEL_IMAGETYPE}', d),'',d)}"
do_image_wic[recrdeps] = "do_build"
#SDCARD supported Pre build bootloader
do_image_wic[depends] += " atf_bootloader_prebuild:do_deploy"

#RUST support for EasyMesh
RUST_PANIC_STRATEGY="${@bb.utils.contains('DISTRO_FEATURES','EasyMesh','abort','',d)}"

#removing itb-image class for kernel6-6
KERNEL_CLASSES_remove = "${@bb.utils.contains_any('DISTRO_FEATURES','kernel6-12 kernel6-6','itb-image','',d)}"
```
